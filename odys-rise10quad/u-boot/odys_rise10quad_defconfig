## odys-rise10quad/u-boot/odys_rise10quad_defconfig
```kconfig
CONFIG_SUPPORT_PASSING_ATAGS=y
CONFIG_ARMV7_LPAE=n
CONFIG_ARM=y
CONFIG_ARCH_SUNXI=y
CONFIG_DEFAULT_DEVICE_TREE="sun8i-odys-rise10quad"
CONFIG_SPL=y
CONFIG_MACH_SUN8I_A33=y
# CONFIG_DRAM_CLK=432
CONFIG_DRAM_CLK=360
#CONFIG_DRAM_CLK=468
#CONFIG_AXP_DCDC5_VOLT=1500
#CONFIG_AXP_DCDC3_VOLT=1520
#CONFIG_DRAM_TIMINGS_DDR3_1066F_1333H=y
CONFIG_DRAM_ZQ=15291
CONFIG_MMC0_CD_PIN="PB4"
CONFIG_USB0_VBUS_PIN="AXP0-VBUS-ENABLE"
CONFIG_USB0_VBUS_DET="AXP0-VBUS-DETECT"
CONFIG_USB0_ID_DET="PH8"
CONFIG_AXP_GPIO=y
# CONFIG_VIDEO_HDMI is not set
CONFIG_VIDEO_LCD_MODE="x:1024,y:600,depth:24,pclk_khz:56000,le:140,ri:160,up:20,lo:10,hs:19,vs:4,sync:3,vmode:0"
CONFIG_VIDEO_LCD_PANEL_LVDS=y
CONFIG_VIDEO_LCD_IF_LVDS=y
CONFIG_VIDEO_LCD_POWER="AXP0-0"
CONFIG_VIDEO_LCD_BL_EN="PH6"
CONFIG_VIDEO_LCD_BL_PWM="PH0"
# CONFIG_SYS_MALLOC_CLEAR_ON_INIT is not set
CONFIG_SPL_STACK=0x8000
CONFIG_SYS_PBSIZE=1024
CONFIG_AXP_DLDO1_VOLT=3300
CONFIG_CONS_INDEX=5
CONFIG_USB_MUSB_HOST=y
# CONFIG_MTD_RAW_NAND=y
# CONFIG_NAND_SUNXI_SPL_ECC_STRENGTH=40
# CONFIG_NAND_SUNXI_SPL_ECC_SIZE=1024
# CONFIG_NAND_SUNXI_SPL_USABLE_PAGE_SIZE=8192
# CONFIG_SYS_NAND_BLOCK_SIZE=0x200000
# CONFIG_SYS_NAND_OOBSIZE=640
# CONFIG_SYS_NAND_PAGE_SIZE=8832
# CONFIG_SYS_NAND_MAX_CHIPS=2
```
